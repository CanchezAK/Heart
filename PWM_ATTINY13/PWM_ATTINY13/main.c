/*
 * PWM_ATTINY13.c
 *
 * Created: 09.12.2021 12:54:43
 * Author : CanchezAK
 */ 
#define F_CPU 4800000UL
#define LED0 PB0

#include <avr/io.h>
#include <util/delay.h>
#include <avr/pgmspace.h>

uint8_t pwr_on = 0;

void pulse();
void delay_us(long us);

void delay_us(long us)
{
	us = us/48;
	do 
	{
		us--;
	}
	while(us != 0);
}

const uint8_t  PWM_table[256] PROGMEM= {
	0 , 0 , 0 , 0 , 0 , 0 , 0 , 0 , 0 , 0 , 0 , 0 , 0 , 0 , 0 , 0,
	0 , 0 , 0 , 0 , 0 , 0 , 0 , 0 , 0 , 1 , 1 , 1 , 1 , 1 , 1 , 1,
	1 , 2 , 2 , 2 , 2 , 2 , 2 , 2 , 3 , 3 , 3 , 3 , 3 , 4 , 4 , 4,
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	220 , 222 , 225 , 227 , 229 , 231 , 234 , 236 , 238 , 240 , 243 , 245 , 247 , 250 , 252 , 255
};

void bpm_pulse(uint32_t pul)
{
	uint8_t bpm = 60000000/pul;
	
	delay_us(bpm/2);
	pulse();
	delay_us(bpm/2);
	pulse();
}

void pulse()
{
	uint8_t count = 0;
	do
	{
		OCR0A = PWM_table[count];
		count++;
		_delay_us(400);
	}
	while(count!=255);
		
	do
	{
		OCR0A = PWM_table[count];
		count--;
		_delay_us(400);
	}
	while (count!=0);
}


int main(void)
{
	asm("cli");
    DDRB |= (1 << LED0);
	PORTB = 0x04;
    TCCR0A = 0x83; // режим ШИМ, неинверсный сигнал на выходе OC0A
    TCCR0B = 0x02;
    TCNT0=0;
    OCR0A=0;
	asm("sei");
	
    while (1) 
    {
		if ((PINB & (1<<2)) == 0)
		{
			bpm_pulse(50);
		}
    }
}

